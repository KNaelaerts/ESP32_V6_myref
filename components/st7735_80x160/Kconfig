## components/st7735_80x160/Kconfig
```kconfig
menu "ST7735 80x160 display"

    config ST7735_PIN_CLK
        int "CLK (SCL) GPIO"
        default 12

    config ST7735_PIN_DATA
        int "DATA (SDA/MOSI) GPIO"
        default 11

    config ST7735_PIN_RST
        int "RESET GPIO"
        default 10

    config ST7735_PIN_DC
        int "DC GPIO"
        default 9

    config ST7735_PIN_CS
        int "CS GPIO"
        default 8

    config ST7735_PIN_BLK
        int "Backlight (BLK) GPIO"
        default 7

    config ST7735_SPI_CLOCK_HZ
        int "SPI clock (Hz)"
        default 20000000

    config ST7735_GAP_X
        int "Panel X offset (26 for most 0.96 inch 80x160 panels)"
        default 26

    config ST7735_GAP_Y
        int "Panel Y offset"
        default 1

    config ST7735_INVERT_COLORS
        bool "Invert colors"
        default y

endmenu
```

## sdkconfig.defaults
```kconfig
CONFIG_LV_FONT_MONTSERRAT_8=y
CONFIG_LV_FONT_MONTSERRAT_10=y
CONFIG_LV_FONT_MONTSERRAT_12=y
CONFIG_LV_USE_QRCODE=y
```
